## conf/layer.conf
```bitbake
# We have a conf and classes directory, add to BBPATH
BBPATH .= ":${LAYERDIR}"

# We have recipes-* directories, add to BBFILES
BBFILES += "${LAYERDIR}/recipes-*/*/*.bb \
            ${LAYERDIR}/recipes-*/*/*.bbappend"

BBFILE_COLLECTIONS += "lichee-bsp"
BBFILE_PATTERN_lichee-bsp = "^${LAYERDIR}/"

BBFILE_PRIORITY_lichee-bsp = "11"

LAYERSERIES_COMPAT_lichee-bsp = "dunfell"

PREFERRED_PROVIDER_virtual/kernel ?= "linux-stable"

KERNEL_IMAGETYPE ?= "zImage"
```

## conf/machine/licheepizero-dock.conf
```bitbake
#@TYPE: Machine
#@NAME: licheepi-zero dock
#@DESCRIPTION: Machine configuration for the LicheePi Zero, based on allwinner V3s CPU

require conf/machine/include/sun8i.inc

KERNEL_DEVICETREE ?= "sun8i-v3s-licheepi-zero-dock.dtb"

# fbturbo seems to be not longer maintained (2018) and patches are needed for new gcc
# as a result, use default fbdev
XSERVER:remove = "\
  xf86-video-fbturbo \
"
XSERVER:append = "\
  xf86-video-fbdev \
"

UBI_VOLNAME = "rootfs"
IMAGE_CLASSES += "squashfs-lz4-ubi"
IMAGE_FSTYPES:append = "${@bb.utils.contains('BOOT_DEV', 'spinor', ' \
  ubi squashfs-lz4', '', d)} \"
IMAGE_FSTYPES:remove = " ext3 sunxi-sdimg"
IMAGE_FSTYPES:remove = "${@bb.utils.contains('BOOT_DEV', 'spinor', ' \
  wic wic.gz wic.bmap', '', d)} \"

# data partition
MKUBIFS_ARGS ?= " --leb-size=1MiB --max-leb-cnt=4032 --min-io-size=1 --compr=lzo --jrn-size=512KiB --log-lebs=2 --space-fixup"
UBINIZE_ARGS ?= " --min-io-size=1 --peb-size=4KiB"

do_image_ubi[depends] += "\
  virtual/bootloader:do_deploy \
  virtual/kernel:do_deploy \
"

#Detected gd25lq128 with page size 256 Bytes, erase size 4 KiB, total 16 MiB
#[  219.189790] ubi0: attaching mtd1
#[  219.573813] ubi0: scanning is finished
#[  219.577628] ubi0: empty MTD device detected
#[  219.663923] ubi0: attached mtd1 (name "ubi", size 15 MiB)
#[  219.669457] ubi0: PEB size: 4096 bytes (4 KiB), LEB size: 3968 bytes
#[  219.675846] ubi0: min./max. I/O unit sizes: 1/256, sub-page size 1
#[  219.682021] ubi0: VID header offset: 64 (aligned 64), data offset: 128
#[  219.688580] ubi0: good PEBs: 4032, bad PEBs: 0, corrupted PEBs: 0
#[  219.694684] ubi0: user volume: 0, internal volumes: 1, max. volumes count: 23
#[  219.701813] ubi0: max/mean erase counter: 0/0, WL threshold: 4096, image sequence number: 3831046384
#[  219.710950] ubi0: available PEBs: 4028, total reserved PEBs: 4, PEBs reserved for bad PEB handling: 0
#[  219.721235] ubi0: background thread "ubi_bgt0d" started, PID 300
#UBI device number 0, total 4032 LEBs (15998976 bytes, 15.2 MiB), available 4028 LEBs (15983104 bytes, 15.2 MiB), LEB size 3968 bytes (3.8 KiB)

#MKUBIFS_ARGS ?= " -e 0x1f000 -c 2048 -m 0x800  -x lzo"                                   
#UBINIZE_ARGS ?= " -m 0x800 -p 0x20000 -s 2048"

# set /boot partition size in MB
SUNXI_BOOT_SPACE = "6"

# define files for /boot partition
IMAGE_BOOT_FILES = " \
  ${@bb.utils.contains('BOOT_DEV', 'sd', '\
    ${KERNEL_IMAGETYPE} \
    ${KERNEL_DEVICETREE} \
    boot.scr ', '', d)} \
"

do_image_wic[depends] += "\
  mtools-native:do_populate_sysroot \
  dosfstools-native:do_populate_sysroot \
  virtual/bootloader:do_deploy \
  virtual/kernel:do_deploy \
"

UBOOT_ENV = "boot"
UBOOT_ENV_SUFFIX = "scr"

BOOT_DEV ?= "sd"

UBOOT_CONFIG ??= "${BOOT_DEV}"
UBOOT_CONFIG[sd] = "LicheePi_Zero_Dock_defconfig,wic"
UBOOT_CONFIG[spinor] = "LicheePi_Zero_Dock_nor_defconfig"

WKS_FILES = "\
  ${@bb.utils.contains('BOOT_DEV', 'sd', 'sunxi-sdcard-image.wks.in', '', d)} \
"

WKS_FILE_DEPENDS += " \
  e2fsprogs-native \
"
```
